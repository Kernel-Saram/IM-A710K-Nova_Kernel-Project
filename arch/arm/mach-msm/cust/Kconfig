## arch/arm/mach-msm/cust/Kconfig
```kconfig
if CUST_PANTECH_H

#
# PANTECH Cust feature section
#

if MACH_MSM8X55_EF18K
config DEFINE_LIST_EF18K
        bool
        default y
	select PANTECH_CAMERA
        select PANTECH_SDCARD
        select PANTECH_SKY_FACTORY_COMMAND
	select PANTECH_USB
	select SKY_BT
	select SKY_SND_EXTAMP
	select SKY_SND_CTRL
endif

if MACH_MSM8X55_EF30S
config DEFINE_LIST_EF30S
	bool
	default y
	select PANTECH_CAMERA
	select PANTECH_SDCARD
	select PANTECH_SKY_FACTORY_COMMAND
	select PANTECH_USB
	select SKY_BT
	select SKY_SND_EXTAMP
	select SKY_SND_CTRL
endif


config PANTECH_CAMERA
	bool

config PANTECH_SDCARD
	bool
	

# config PANTECH_EF36S_AUDIO_MAX97001
# 	bool
# config PANTECH_EF36S_AUDIO_MARIMBA_SETTING
# 	bool
# config PANTECH_EF36S_AUDIO_SUBCHIP_CAL_TOOL
# 	bool
# config PANTECH_EF36S_ASR_PATH
# 	bool


config PANTECH_ERR_CRASH_LOGGING
	bool


config SKY_BT
	bool
config BRCM_BT_HID
	bool	

config PANTECH_SKY_FACTORY_COMMAND
	bool	

config PANTECH_USB
	bool

config SKY_SND_EXTAMP
        bool 
        
config SKY_SND_CTRL
        bool 

endif
```

## drivers/input/sensor/Kconfig
```kconfig
#
# Sensor driver configuration
#
menuconfig INPUT_SENSOR
	bool "Sensors"
	default y
	help
	  Say Y here, and a list of supported sensorss will be displayed.
	  This option doesn't affect the kernel.

	  If unsure, say Y.

if INPUT_SENSOR

#### EF18K ####
if MACH_MSM8X55_EF18K
config EF18K_SENSORS_APDS9900
	tristate "Avago apds9900 proximity and light sensor"
	depends on I2C
	default n
	help
	  Say Y here if you have a APDS9900 sensor and want to enable
	  support for the built-in sensor.

config EF18K_SENSORS_BMA150
	tristate "Bocsh bma150 accelerometer sensor"
	depends on I2C
	default n
	help
	  Say Y here if you have a bma150 sensor and want to enable
	  support for the built-in sensor.

config EF18K_SENSORS_YAS529
	tristate "Yamaha yas529 magnetic field sensor"
	depends on I2C
	default n
	help
	  Say Y here if you have a yas529 sensor and want to enable
	  support for the built-in sensor.
endif

#### EF30S ####
if MACH_MSM8X55_EF30S
config EF30S_SENSORS_APDS9900
	tristate "Avago apds9900 proximity and light sensor"
	depends on I2C
	default n
	help
	  Say Y here if you have a APDS9900 sensor and want to enable
	  support for the built-in sensor.

config EF30S_SENSORS_BMA150
	tristate "Bocsh bma150 accelerometer sensor"
	depends on I2C
	default n
	help
	  Say Y here if you have a bma150 sensor and want to enable
	  support for the built-in sensor.

config EF30S_SENSORS_YAS529
	tristate "Yamaha yas529 magnetic field sensor"
	depends on I2C
	default n
	help
	  Say Y here if you have a yas529 sensor and want to enable
	  support for the built-in sensor.

config EF30S_SENSORS_L3G4200D
 	tristate "ST l3g4200d gyro sensor"
 	depends on I2C
 	default n
 	help
 	  Say Y here if you have a L3G4200D sensor and want to enable
 	  support for the built-in sensor.
endif

endif
```

## drivers/net/wireless/bcm4329/Kconfig
```kconfig
config BCM4329
	tristate "Broadcom BCM4329 wireless chip support"
	depends on WIRELESS_EXT && MMC
	---help---
	  This module adds support for wireless adapters based on
	  Broadcom 4329 chipset.

	  This driver uses the kernel's wireless extensions subsystem.

config BCM4329_PT_PATCH
	depends on BCM4329
	bool "BCM4329 Pantech Patch"
	default y

config BCM4329_WL_RESET_GPIO
	depends on BCM4329 && BCM4329_PT_PATCH
	int "BCM4329 WLAN Reset GPIO number"
	default 55

config BCM4329_FW_PATH
	depends on BCM4329
	string "Firmware path"
	default "/etc/wl/bcm4329.bin"
	---help---
	  Path to the firmware file.

config BCM4329_NVRAM_PATH
	depends on BCM4329
	string "NVRAM path"
	default "/etc/wl/nvram.txt"
	---help---
	  Path to the nvram file.

config BCM4329_IFACE_NAME
	depends on BCM4329 && BCM4329_PT_PATCH
	string "Wireless network interface name"
	default "wlan"

config BCM4329_DEBUG
	depends on BCM4329
	bool "Debug"
	default n

config BCM4329_SOFTAP
	depends on BCM4329
	bool "Support SoftAP function"
	default y

config BCM4329_RAND_MAC
	depends on BCM4329 && BCM4329_PT_PATCH
	bool "Generating random MAC address"
	default n

config BCM4329_OOB_GPIO
	depends on BCM4329
	int "BCM4329 out-of-band GPIO number"
	default 68

config BCM4329_WLANMAC_PATH
	depends on BCM4329 && BCM4329_PT_PATCH
	string "WLAN MAC path"
	default "/dev/panmac"
	---help---
	  Path to the wlan mac address file.

config BCM4329_ROAM_ENABLE
    depends on BCM4329
    bool "Enable roaming"
    default n
```
